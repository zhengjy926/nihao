## boards/alientek/f429igt6/Kconfig.f429igt6
```kconfig
# SPDX-License-Identifier: Apache-2.0

config BOARD_F429IGT6
	select SOC_STM32F429XX
```

## boards/alientek/f429igt6/board.yml
```yaml
board:
  name: f429igt6
  full_name: ALIENTEK Explorer STM32F429IGT6
  vendor: alientek
  socs:
    - name: stm32f429xx
```

## boards/psg/g474qet6/Kconfig.g474qet6
```kconfig
# SPDX-License-Identifier: Apache-2.0

config BOARD_G474QET6
	select SOC_STM32G474XX
```

## boards/psg/g474qet6/board.yml
```yaml
board:
  name: g474qet6
  full_name: PSG pulse generator STM32G474QET6
  vendor: psg
  socs:
    - name: stm32g474xx
```

## boards/psg/g474qet6/g474qet6_defconfig
```kconfig
# SPDX-License-Identifier: Apache-2.0

CONFIG_SYS_CLOCK_HW_CYCLES_PER_SEC=170000000

CONFIG_GPIO=y
CONFIG_PINCTRL=y
CONFIG_CLOCK_CONTROL=y
CONFIG_SERIAL=y
```
