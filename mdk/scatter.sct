; Generated by tools/gen_project.py - do not edit.
;
; Note: armlink only honours explicit section selectors in regions without a
; fixed base address. Every iterable list therefore gets its own "+0" region.
LR_IROM1 0x08000000 0x00100000
{
  ER_IROM1 0x08000000 0x00100000
  {
    *(RESET, +First)
    *(InRoot$$Sections)
    .ANY (+RO)
  }
  ER_INIT_EARLY +0
  {
    *(.aaa_EARLY_begin)
    *(.z_init_EARLY_P_*)
    *(.zzz_EARLY_end)
  }
  ER_INIT_PRE_KERNEL_1 +0
  {
    *(.aaa_PRE_KERNEL_1_begin)
    *(.z_init_PRE_KERNEL_1_P_*)
    *(.zzz_PRE_KERNEL_1_end)
  }
  ER_INIT_PRE_KERNEL_2 +0
  {
    *(.aaa_PRE_KERNEL_2_begin)
    *(.z_init_PRE_KERNEL_2_P_*)
    *(.zzz_PRE_KERNEL_2_end)
  }
  ER_INIT_POST_KERNEL +0
  {
    *(.aaa_POST_KERNEL_begin)
    *(.z_init_POST_KERNEL_P_*)
    *(.zzz_POST_KERNEL_end)
  }
  ER_INIT_APPLICATION +0
  {
    *(.aaa_APPLICATION_begin)
    *(.z_init_APPLICATION_P_*)
    *(.zzz_APPLICATION_end)
  }
  ER_INIT_SMP +0
  {
    *(.aaa_SMP_begin)
    *(.z_init_SMP_P_*)
    *(.zzz_SMP_end)
  }

  ER_INTLIST +0
  {
    *(.nihao_intlist_begin, +First)
    *(.intList)
  }

  ER_INTLIST_END +0
  {
    *(.nihao_intlist_end)
  }

  ER_LOG_CONST +0
  {
    *(.nihao_log_const_begin, +First)
    *(._log_const.static.*)
    *(.nihao_log_const_end, +Last)
  }

  ER_LOG_BACKEND +0
  {
    *(.nihao_log_backend_begin, +First)
    *(._log_backend.static.*)
    *(.nihao_log_backend_end, +Last)
  }

  ER_DEVICE +0
  {
    *(.nihao_device_begin, +First)
    *(._device.static.*)
    *(.nihao_device_end, +Last)
  }

  RW_IRAM1 0x20000000 0x0002DE00
  {
    .ANY (+RW +ZI)
  }

  ER_LOG_MSG_PTR +0
  {
    *(.nihao_log_msg_ptr_begin, +First)
    *(._log_msg_ptr.static.*)
  }

  ER_LOG_MSG_PTR_END +0
  {
    *(.nihao_log_msg_ptr_end)
  }

  ER_LOG_DYNAMIC +0
  {
    *(.nihao_log_dynamic_begin, +First)
    *(._log_dynamic.static.*)
  }

  ER_LOG_DYNAMIC_END +0
  {
    *(.nihao_log_dynamic_end)
  }

  ER_LOG_LINK +0
  {
    *(.nihao_log_link_begin, +First)
    *(._log_link.static.*)
  }

  ER_LOG_LINK_END +0
  {
    *(.nihao_log_link_end)
  }

  ER_LOG_MPSC +0
  {
    *(.nihao_log_mpsc_pbuf_begin, +First)
    *(._log_mpsc_pbuf.static.*)
  }

  ER_LOG_MPSC_END +0
  {
    *(.nihao_log_mpsc_pbuf_end)
  }

  ER_HEAP 0x2002DE00 UNINIT 0x00000200
  {
    *(HEAP)
  }

  ER_STACK 0x2002E000 UNINIT 0x00002000
  {
    *(STACK)
  }
}
